## conf/layer.conf
```bitbake
# We have a conf and classes directory, add to BBPATH
BBPATH .= ":${LAYERDIR}"

# We have a recipes-* directories, add to BBFILES
BBFILES += "${LAYERDIR}/recipes-*/*/*.bb \
	${LAYERDIR}/recipes-*/*/*.bbappend"
# meta-efi-secure
BBFILES += "${LAYERDIR}/meta-efi-secure/recipes-*/*/*.bb \
»···${LAYERDIR}/meta-efi-secure/recipes-*/*/*.bbappend"


BBFILE_COLLECTIONS += "stm-st-stm32mp-oss"
BBFILE_PATTERN_stm-st-stm32mp-oss := "^${LAYERDIR}/"
BBFILE_PRIORITY_stm-st-stm32mp-oss = "6"

EULA_FILE_ST:stm32mpcommon = "${LAYERDIR}/conf/eula/${MACHINE}"
EULA_FILE_ST_MD5SUM:stm32mpcommon = "8b505090fb679839cefbcc784afe8ce9"

# Set a variable to get the STM32MP BSP location
STM32MP_OSS_BASE = "${LAYERDIR}"

# This should only be incremented on significant changes that will
# cause compatibility issues with other layers
LAYERVERSION_stm-st-stm32mp-oss = "1"
LAYERSERIES_COMPAT_stm-st-stm32mp-oss = "nanbield"

# meta-python for optee-os-stm32mp dependency and efitools
# meta-perl for efitools dependency
LAYERDEPENDS_stm-st-stm32mp-oss = "core openembedded-layer meta-python perl-layer"
```

## conf/machine/stm32mp13-disco-oss.conf
```bitbake
#@TYPE: Machine
#@NAME: stm32mp13-disco-oss
#@DESCRIPTION: Configuration for STM32MP135f-DK board (OPTEE boot and SDcard only)
#@NEEDED_BSPLAYERS: layers/meta-openembedded/meta-oe layers/meta-openembedded/meta-python layers/meta-openembedded/meta-perl

include conf/machine/include/arm/armv7a/tune-cortexa7.inc

DEFAULTTUNE = "cortexa7thf-neon-vfpv4"

# Define specific familly common machine name
MACHINEOVERRIDES .= ":stm32mp13common:stm32mposscommon:stm32mp1common:stm32mpcommon"

STM32MP_SOC_NAME = "stm32mp13"

# =========================================================================
# MACHINE FEATURE
# =========================================================================
MACHINE_FEATURES = "ext2 ipsec nfs pci smbfs usbgadget usbhost vfat"
MACHINE_FEATURES += "wifi bluetooth splashscreen"
MACHINE_FEATURES += "watchdog"
MACHINE_FEATURES += "optee"
MACHINE_FEATURES += "nosmp"
MACHINE_FEATURES += "fw-update"

MACHINE_FEATURES += "autoresize initrd"
# =========================================================================
# Kernel
# =========================================================================
# Select kernel version
PREFERRED_PROVIDER_virtual/kernel = "linux-stm32mp-oss"
# Kernel image type
KERNEL_IMAGETYPE     =  "uImage"
KERNEL_ALT_IMAGETYPE = " zImage "

KERNEL_DEVICETREE = "stm32mp135f-dk.dtb"
SERIAL_CONSOLE = "115200 ttySTM0"
ST_KERNEL_LOADADDR ?= "0xC2000040"

KERNEL_CMDLINE ?= "console=ttySTM0,115200 rootwait rw root=PARTLABEL=rootfs"
# =========================================================================
# u-boot
# =========================================================================
PREFERRED_PROVIDER_virtual/bootloader = "u-boot-stm32mp-oss"
PREFERRED_PROVIDER_u-boot = "u-boot-stm32mp-oss"

EXTRA_IMAGEDEPENDS += "virtual/bootloader"

UBOOT_CONFIG = "stm32mp135f-dk"
UBOOT_DEVICETREE = "stm32mp135f-dk.dtb"
# Define u-boot defconfig and binary to use for each UBOOT_CONFIG
UBOOT_CONFIG[stm32mp135f-dk] = "stm32mp13_disco_defconfig,,u-boot.bin"
# =========================================================================
# tf-a
# =========================================================================
PREFERRED_PROVIDER_virtual/trusted-firmware-a = "tf-a-stm32mp-oss"

EXTRA_IMAGEDEPENDS += "virtual/trusted-firmware-a"

# Add optionnaly tf-a
TF_A_DEVICETREE = "stm32mp135f-dk"
TF_A_DEVICETREE_SDCARD  = "stm32mp135f-dk"
TF_A_DEVICETREE_EMMC    = ""
TF_A_DEVICETREE_NAND    = ""
TF_A_DEVICETREE_NOR     = ""
#TF_A_DEVICETREE_SPINAND = ""

# =========================================================================
# OPTEE
# =========================================================================
PREFERRED_PROVIDER_virtual/optee-os = "optee-os-stm32mp-oss"

EXTRA_IMAGEDEPENDS += "virtual/optee-os"

# Map OPTEE configuration to device tree list
OPTEE_CONF = "stm32mp135f-dk "
OPTEE_CONF_EXTENDED = "stm32mp135f-dk:PLATFORM=stm32mp1-135F_DK"
# need to have a version of optee-client and optee-test aligned with optee-os
PREFERRED_PROVIDER_optee-client = "optee-client-oss"
PREFERRED_PROVIDER_optee-test = "optee-test-oss"

# =========================================================================
# MACHINE
# =========================================================================
IMAGE_CLASSES += " image_types-st"
IMAGE_FSTYPES  += " ext4 tar.xz stbootfs ${WKS_IMAGE_FSTYPES}"

# bluetooth
BLUETOOTH_LIST          = " linux-firmware-bluetooth-bcm4343 "
BLUETOOTH_LIST         += "${@bb.utils.contains('DISTRO_FEATURES','systemd',' bluetooth-suspend ','',d)}"
BLUETOOTH_IMAGE_INSTALL = "${@bb.utils.contains('MACHINE_FEATURES', 'bluetooth', '${BLUETOOTH_LIST}', '', d)} "

# Wifi
WIFI_LIST          = " linux-firmware-bcm43430 "
WIFI_IMAGE_INSTALL = "${@bb.utils.contains('MACHINE_FEATURES', 'wifi', '${WIFI_LIST}', '', d)} "

MACHINE_EXTRA_RDEPENDS += " \
    ${BLUETOOTH_IMAGE_INSTALL} \
    ${WIFI_IMAGE_INSTALL} \
    \
    kernel-image \
    kernel-modules \
    alsa-state-stm32mp1 alsa-state-script-oss \
    linux-firmware-bluetooth-bcm4343 \
    stm32mp-extlinux \
    ${@bb.utils.contains('MACHINE_FEATURES', 'splashscreen', 'u-boot-stm32mp-splash', '', d)} \
    efivar efibootmgr \
"
MACHINE_EXTRA_RRECOMMENDS += " \
    flashlayout \
    sdcard-raw-tools-native \
"

# =========================================================================
# Partition coming compatibility with meta-st-stm32mp and meta-st-opensstlinux
# =========================================================================
ST_BOOTFS = "0"
ST_VENDORFS = "0"
ST_USERFS = "0"

# =========================================================================
# WIC for sdcard raw image
# =========================================================================
#WIC_CREATE_EXTRA_ARGS = "--no-fstab-update"
WKS_FILE_DEPENDS ?= " \
    virtual/bootloader \
    virtual/trusted-firmware-a \
    stm32mp-oss-doc-native \
    flashlayout \
    sdcard-raw-tools-native \
    e2fsprogs-native \
"

# for generated a WIC file, please uncomment the 2 following lines or add them to local.conf
WKS_IMAGE_FSTYPES = "wic wic.xz wic.bmap"
WKS_FILE += "sdcard-stm32mp135f-dk-optee-1GB.wks.in"

# Add more space on image
IMAGE_ROOTFS_EXTRA_SPACE = "131072"
```

## conf/machine/stm32mp15-eval-oss.conf
```bitbake
#@TYPE: Machine
#@NAME: stm32mp15-eval-oss
#@DESCRIPTION: Configuration for STM32MP157C-EV1 board (OPTEE boot and SDcard only)
#@NEEDED_BSPLAYERS: layers/meta-openembedded/meta-oe layers/meta-openembedded/meta-python layers/meta-openembedded/meta-perl

include conf/machine/include/arm/armv7a/tune-cortexa7.inc

DEFAULTTUNE = "cortexa7thf-neon-vfpv4"

# Define specific familly common machine name
MACHINEOVERRIDES .= ":stm32mp15common:stm32mposscommon:stm32mp1common:stm32mpcommon"

STM32MP_SOC_NAME = "stm32mp15"

# =========================================================================
# MACHINE FEATURE
# =========================================================================
MACHINE_FEATURES = "ext2 ipsec nfs pci smbfs usbgadget usbhost vfat"
MACHINE_FEATURES += "splashscreen"
MACHINE_FEATURES += "watchdog"
MACHINE_FEATURES += "optee"
MACHINE_FEATURES += "fw-update"

#MACHINE_FEATURES += "efi"

MACHINE_FEATURES += "autoresize initrd"

# =========================================================================
# CONSOLE
# =========================================================================
SERIAL_CONSOLE = "115200 ttySTM0"
SERIAL_CONSOLES = "${@d.getVar('SERIAL_CONSOLE').replace(' ', ';')}"
# =========================================================================
# Kernel
# =========================================================================
# Select kernel version
PREFERRED_PROVIDER_virtual/kernel = "linux-stm32mp-oss"
# Kernel image type
KERNEL_IMAGETYPE     =  "uImage"
KERNEL_ALT_IMAGETYPE = " zImage "

KERNEL_DEVICETREE = "st/stm32mp157c-ev1.dtb"

SERIAL_CONSOLE = "115200 ttySTM0"
ST_KERNEL_LOADADDR ?= "0xC2000040"

KERNEL_CMDLINE ?= "console=ttySTM0,115200 rootwait rw root=PARTLABEL=rootfs"
# =========================================================================
# u-boot
# =========================================================================
PREFERRED_PROVIDER_virtual/bootloader = "u-boot-stm32mp-oss"
PREFERRED_PROVIDER_u-boot = "u-boot-stm32mp-oss"

EXTRA_IMAGEDEPENDS += "virtual/bootloader"

UBOOT_CONFIG = "stm32mp157c-ev1"
UBOOT_DEVICETREE = "stm32mp157c-ev1.dtb"
# Define u-boot defconfig and binary to use for each UBOOT_CONFIG
UBOOT_CONFIG[stm32mp157c-ev1] = "stm32mp15_eval_defconfig,,u-boot.bin"
# =========================================================================
# tf-a
# =========================================================================
PREFERRED_PROVIDER_virtual/trusted-firmware-a = "tf-a-stm32mp-oss"

EXTRA_IMAGEDEPENDS += "virtual/trusted-firmware-a"

# Add optionnaly tf-a
TF_A_DEVICETREE = "stm32mp157c-ev1"
TF_A_DEVICETREE_SDCARD  = "stm32mp157c-ev1"
TF_A_DEVICETREE_EMMC    = "stm32mp157c-ev1"
TF_A_DEVICETREE_NAND    = "stm32mp157c-ev1"
TF_A_DEVICETREE_NOR     = "stm32mp157c-ev1"
#TF_A_DEVICETREE_SPINAND = "stm32mp157c-ev1"


# =========================================================================
# OPTEE
# =========================================================================
PREFERRED_PROVIDER_virtual/optee-os = "optee-os-stm32mp-oss"

EXTRA_IMAGEDEPENDS += "virtual/optee-os"

# Map OPTEE configuration to device tree list
OPTEE_CONF = "stm32mp157c-ev1"
OPTEE_CONF_EXTENDED = "stm32mp157c-ev1:PLATFORM=stm32mp1-157C_EV1"
# need to have a version of optee-client and optee-test aligned with optee-os
PREFERRED_PROVIDER_optee-client = "optee-client-oss"
PREFERRED_PROVIDER_optee-test = "optee-test-oss"

ST_OPTEE_NO_SHAREDMEMORY = "1"
# =========================================================================
# MACHINE
# =========================================================================
#IMAGE_CLASSES += " image_types-st image_types-stubi"
#IMAGE_FSTYPES  += " ext4 tar.xz stbootfs ubifs stmultiubi ${WKS_IMAGE_FSTYPES}"
IMAGE_FSTYPES  += " ext4 tar.xz ${WKS_IMAGE_FSTYPES}"

# UBI for nand 4 256
MULTIUBI_BUILD += "nand"
MKUBIFS_ARGS = "--min-io-size 4096 --leb-size 253952 --max-leb-cnt 4096"
UBINIZE_ARGS = "--min-io-size 4096 --peb-size 256KiB"

MKUBIFS_ARGS:nand = "--min-io-size 4096 --leb-size 253952 --max-leb-cnt 4096"
UBINIZE_ARGS:nand = "--min-io-size 4096 --peb-size 256KiB"
EXTRA_UBIFS_SIZE:nand = "2304"
STM32MP_UBI_VOLUME:nand:prepend = "\
    uboot_config:256:empty \
    uboot_config_r:256:empty \
    ${IMAGE_NAME}:755968KiB \
    "

MACHINE_EXTRA_RDEPENDS += " \
    kernel-image \
    kernel-modules \
    alsa-state-stm32mp1 alsa-state-script-oss \
    linux-firmware-bluetooth-bcm4343 \
    stm32mp-extlinux \
    ${@bb.utils.contains('MACHINE_FEATURES', 'splashscreen', 'u-boot-stm32mp-splash', '', d)} \
"
#MACHINE_EXTRA_RDEPENDS += "efivar efibootmgr"

MACHINE_EXTRA_RRECOMMENDS += " \
    flashlayout \
    sdcard-raw-tools-native \
"

# =========================================================================
# Partition coming compatibility with meta-st-stm32mp and meta-st-opensstlinux
# =========================================================================
ST_BOOTFS = "0"
ST_VENDORFS = "0"
ST_USERFS = "0"

# =========================================================================
# WIC for sdcard raw image
# =========================================================================
#WIC_CREATE_EXTRA_ARGS = "--no-fstab-update"
WKS_FILE_DEPENDS ?= " \
    virtual/bootloader \
    virtual/trusted-firmware-a \
    stm32mp-oss-doc-native \
    flashlayout \
    sdcard-raw-tools-native \
    e2fsprogs-native \
"

# for generated a WIC file, please uncomment the 2 following lines or add them to local.conf
WKS_IMAGE_FSTYPES = "wic wic.xz wic.bmap"
WKS_FILE = "sdcard-stm32mp157c-ev1-optee-1GB.wks.in"

# Add more space on image
IMAGE_ROOTFS_EXTRA_SPACE = "131072"
```
